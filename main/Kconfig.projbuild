## main/Kconfig.projbuild
```kconfig
menu "STA2ETH Bridge Configuration"

    orsource "$IDF_PATH/examples/common_components/env_caps/$IDF_TARGET/Kconfig.env_caps"

    config EXAMPLE_RECONFIGURE_BUTTON
        int "GPIO Button for WiFi Reconfiguration"
        range ENV_GPIO_RANGE_MIN ENV_GPIO_IN_RANGE_MAX
        default 2
        help
            GPIO pin for the button to trigger WiFi reconfiguration.
            Long press (2 seconds) to enter WiFi configuration portal.

endmenu
```

## sdkconfig.defaults.esp32p4
```kconfig
# ==================== ESP32-P4 Specific Configuration ====================
# Target-specific settings for P4+C6 hosted architecture

# ==================== CPU Frequency ====================
# 360MHz provides good balance of performance and power
CONFIG_ESP_DEFAULT_CPU_FREQ_MHZ_360=y
CONFIG_ESP_DEFAULT_CPU_FREQ_MHZ=360

# ==================== WiFi Remote (SDIO) Configuration ====================
# Buffer configuration for P4<->C6 communication via SDIO
# These values are tuned for stable bridge operation
CONFIG_WIFI_RMT_STATIC_RX_BUFFER_NUM=16
CONFIG_WIFI_RMT_DYNAMIC_RX_BUFFER_NUM=32
CONFIG_WIFI_RMT_DYNAMIC_TX_BUFFER_NUM=32
```
